/*
 * STM32Lxx_ADC_Driver.c
 *
 *  Created on: Sep 24, 2025
 *      Author: HP
 */

/**********************************************************************************************************************
 * Include files
**********************************************************************************************************************/
#include"STM32Lxx.h"
#include"STM32Lxx_ADC_header.h"
#include "STM32Lxx_gpio_header.h"
/*********************************************** end of Include files ************************************************/

/**********************************************************************************************************************
 * PRAGMAS
**********************************************************************************************************************/

/******************************************** end of PRAGMAs *********************************************************/

/**********************************************************************************************************************
 * Global Variables
**********************************************************************************************************************/
/* Flags used to indicate updated data is received*/


/*************************************** end of Global Variables ****************************************************/

/*********************************************************************************************************************
 * Static Function Prototypes
*********************************************************************************************************************/

/***************************************** end of Static Function Prototypes ****************************************/

/*********************************************************************************************************************
 * Function Definitions
*********************************************************************************************************************/

/*********************************************************************************************************************
* Function name      :
* Description        :
*
* Passing Arguments  : None
* Function Called By :
* Return value       : None
*********************************************************************************************************************/


/************************************************ end of Function Definitions ****************************************/
void ADC_init(void)
{
	GPIOA_PCLK_EN();
	RCC->AHB2ENR |= RCC_AHB2ENR_ADCEN;

	GPIOA->MODER |= (3U <<(0*2));
	GPIOA->PUPDR &= ~(3U <<(0*2));
	GPIOA->ASCR  |= (1U <<(0));

	ADCOM->CCR &=~ ADC_CCR_CKMODE;
	ADCOM->CCR |= ADC_CCR_CKMODE_DIV1;

	ADC1->CR &=~ ADC_CR_DEEPPWD;
	ADC1->CR |= ADC_CR_ADVREGEN;

	ADC_delay();

	ADC1->CR |= ADC_CR_ADCAL;
	while(ADC1->CR & ADC_CR_ADCAL);

	ADC1->SMPR1 &=~(0x7U <<(5*3));
	ADC1->SMPR1 |=(0x2U <<(5*3));

	ADC1->SQR1 &=~(ADC_SQR1_L);
	ADC1->SQR1 &=~(0x1FU << 6U);
	ADC1->SQR1 |= (5U<<6U);

	ADC1->ISR |= ADC_ISR_ADRDY;
	ADC1->CR  |=(ADC_CR_ADEN);
	while(!(ADC1->ISR &ADC_ISR_ADRDY));

}
void ADC_startConvertion(void)
{
	ADC1->CR |= (1<<2);
}
uint16_t ADC_read(void)
{
	while(!(ADC1->ISR & ADC_ISR_EOC));

	return (uint16_t)ADC1->DR;
}

void ADC_delay(void)
{
	for (volatile int i = 0; i < 1000; i++);
}
/************************************************ end of Samples_APP.c ***************************************************/
